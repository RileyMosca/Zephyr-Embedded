## CMakeLists.txt
```
# SPDX-License-Identifier: Apache-2.0

# Setting Minimum CMake version
cmake_minimum_required(VERSION 3.20.0)

# Setting board to the Nordic Semiconductor NRD52840 Board
set(BOARD nrf52840dongle_nrf52840)

set(CONFS_DIR ~/csse4011/repo/prac2/bsu/configs)             # PRAC TWO ~/csse4011/repo/prac2/bsu/confs
set(BOARDS_DIR ~/csse4011/repo/prac2/bsu/boards)             # PRAC TWO ~/csse4011/repo/prac2/bsu/boards

# Setting Config files
set(CONF_FILE 
  prj.conf 
  usb_cdc.conf 
  bt.conf 
  console.conf
)

set(DTC_OVERLAY ${BOARDS_DIR}/nrf52840dongle_nrf52840.overlay)

# Finding the Zephyr Base Package
find_package(Zephyr REQUIRED HINTS $ENV{ZEPHYR_BASE})

# Initialising project as Prac 1
project(prac2)

# Setting CMAKE Relative Directory
set(CMAKE_DIR ~/csse4011/repo/prac2/bsu)

# Setting Global app_sources as relative to ahu -> ahu/src/
FILE(GLOB app_sources ${CMAKE_DIR}/src/*.c)

# Setting Target Source for app under app sources
target_sources(app PRIVATE ${app_sources})

# Setting required directories
set(REPO_DIR            ~/csse4011/repo/)                   # REPOSITORY ~/csse4011/repo
set(PRAC_TWO_DIR        ${REPO_DIR}/prac2)                  # PRAC TWO ~/csse4011/repo/prac2
set(BSU_SRC             ${PRAC_TWO_DIR}/bsu/src/)           # BSU SOURCE ~/csse4011/repo/prac2/bsu/src/
set(OSLIB_DIR           ${REPO_DIR}/oslib/)                 # OSLIB ~/csse4011/repo/oslib/
set(AHU_HCI_SRC_DIR     ${OSLIB_DIR}/ahu_drivers/ahu_hci/)  # AHU HCI SRC ~/csse4011/repo/oslib/ahu_drivers/ahu_hci/

# Including target sources as private
target_include_directories(app PRIVATE 
  ${REPO_DIR}
  ${PRAC_TWO_DIR}
  ${BSU_SRC}
  ${OSLIB_DIR}
  ${AHU_HCI_SRC_DIR}
)

target_sources(app PRIVATE 
  ${AHU_HCI_SRC_DIR}/shell_cli.c      # Including SHELL Command Line Interface (cli)
  ${AHU_HCI_SRC_DIR}/ahu_hci.c        # Including SHELL Command Line Interface (cli)
  ${AHU_HCI_SRC_DIR}/bsu_base.c
  ${BSU_SRC}/main.c               # Including main.c
)

# zephyr_library_include_directories(${ZEPHYR_BASE}/samples/bluetooth)
```

## prj.conf
```kconfig
#--------------------------------SHELL_CONF-----------------------------------
CONFIG_UART_LINE_CTRL=y
CONFIG_SHELL=y
CONFIG_SHELL_PROMPT_UART="Team 1 - CSSE4011:~$ "
CONFIG_SHELL_CMDS=y
CONFIG_SHELL_TAB=y
CONFIG_SHELL_TAB_AUTOCOMPLETION=y
CONFIG_SHELL_VT100_COLORS=y
CONFIG_STATS_SHELL=y

#-------------------------------SHELL_LOGGING---------------------------------
CONFIG_LOG=y
CONFIG_LOG_PRINTK=y
CONFIG_LOG_BUFFER_SIZE=1024
CONFIG_LOG_OVERRIDE_LEVEL=3

#-------------------------------GPIO_CONFIGS----------------------------------
CONFIG_GPIO=y
CONFIG_PRINTK=y
CONFIG_CBPRINTF_FP_SUPPORT=y

#----------------------------------USB SETUP----------------------------------
# CONFIG_USB_DEVICE_STACK=y
# CONFIG_USB_DEVICE_PRODUCT="USB - NRF52840 (Riley Mosca)"
# CONFIG_USB_DEVICE_MANUFACTURER="Riley Mosca"
# CONFIG_USB_DEVICE_VID=0xC553
# CONFIG_USB_DEVICE_PID=0x4011

#------------------------------LED_STRIP_CONFIGS------------------------------
# CONFIG_LED_STRIP=y
# CONFIG_LED_STRIP_LOG_LEVEL_DBG=y
# CONFIG_WS2812_STRIP=y

#--------------------------------OTHER_CONFIGS--------------------------------
CONFIG_INIT_STACKS=y
CONFIG_THREAD_STACK_INFO=y
CONFIG_KERNEL_SHELL=y
CONFIG_THREAD_MONITOR=y
CONFIG_BOOT_BANNER=n
CONFIG_THREAD_NAME=y
CONFIG_DEVICE_SHELL=y
CONFIG_POSIX_CLOCK=y
CONFIG_DATE_SHELL=y
CONFIG_THREAD_RUNTIME_STATS=y
CONFIG_THREAD_RUNTIME_STATS_USE_TIMING_FUNCTIONS=y
CONFIG_STATS=y
CONFIG_HEAP_MEM_POOL_SIZE=256
#--------------------------------UART_CONFIG-------------------------------
CONFIG_SERIAL=y
CONFIG_CONSOLE=y
CONFIG_UART_CONSOLE=y
CONFIG_UART_INTERRUPT_DRIVEN=y

#---------------------------------UNUSED-----------------------------------
# CONFIG_UART_LINE_CTRL=y
# CONFIG_STDOUT_CONSOLE=y

#--------------------------------------------------------------------------
```

## bt.conf
```kconfig
# CONFIG_BT=y
CONFIG_BT_DEVICE_NAME="Riley"
# CONFIG_BT_CENTRAL=y
# CONFIG_BT_SETTINGS=y
# CONFIG_BT_GATT_CLIENT=y
# CONFIG_BT_DIS=y
# CONFIG_BT_SMP=y
# CONFIG_BT_SHELL=y
# CONFIG_BT_CTLR_TX_PWR_PLUS_8=y

CONFIG_BT_CENTRAL=y
CONFIG_BT=y
CONFIG_BT_SETTINGS=y
CONFIG_BT_GATT_CLIENT=y
# CONFIG_BT_CREATE_CONN_TIMEOUT=4

#Enable data signing which is used for transferring authenticated data in an unencrypted connection.
# CONFIG_BT_SIGNING=y
```

## src/main.c
```c
/**
 ************************************************************************
 * @file main.c
 * @author Wilfred MK, Aaron Helmore
 * @date 04.03.2021
 * @brief Spawns threads required by Base node.
 **********************************************************************
 **/

/* Zephyr Includes */
#include <zephyr/types.h>
#include <stddef.h>
#include <errno.h>
#include <zephyr.h>
#include <sys/printk.h>
#include <drivers/gpio.h>
#include <usb/usb_device.h>

/* Local Includes */
#include "bsu_base.h"
// #include "ahu_hci.h"
#include "shell_cli.h"

/**
 * @brief Enable USB Driver.
 * 
 */
void main(void) {

    /*
        Register and initialise the shell
    */
    ahu_cli_shell_init();

    /*
        Enable the USB for the NRF52840 Dongle
    */
	if (usb_enable(NULL)) {
		return;
    }
}
```
